## main/Kconfig.projbuild
```kconfig
menu "Default Configuration"

    config DEFAULT_WIFI_SSID
        string "Default WiFi SSID"
        default "TP-Link_7069"
        help
            Fallback WiFi SSID if not provisioned via SoftAP.

    config DEFAULT_WIFI_PASSWORD
        string "Default WiFi Password"
        default "85784918"
        help
            Fallback WiFi password if not provisioned via SoftAP.

    config DEFAULT_BROKER_ADDR
        string "Default Broker Address"
        default "192.168.1.12"
        help
            Fallback MQTT broker IP or hostname. Topics are derived from
            device MAC: site/<mac>/telemetry, site/<mac>/cmd, site/<mac>/status.

endmenu
```

## sdkconfig.defaults
```kconfig
CONFIG_IDF_TARGET="esp32s3"
CONFIG_MQTT_PROTOCOL_5=y
CONFIG_DEFAULT_BROKER_ADDR="192.168.1.12"
```
